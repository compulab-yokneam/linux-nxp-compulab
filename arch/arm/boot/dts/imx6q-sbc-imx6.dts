/*
* Copyright 2016 CompuLab Ltd.
*
* Author: Valentin Raevsky <valentin@compulab.co.il>
*
* The code contained herein is licensed under the GNU General Public
* License. You may obtain a copy of the GNU General Public License
* Version 2 or later at the following locations:
*
* http://www.opensource.org/licenses/gpl-license.html
* http://www.gnu.org/copyleft/gpl.html
*/

/dts-v1/;
#include "imx6q.dtsi"
#include "imx6q-cl-som-imx6.dtsi"
#include "imx6q-cm-fx6.dtsi"
#include "imx6qdl-sb-fx6x.dtsi"
#include "imx6qdl-sb-fx6.dtsi"

/ {
	model = "CompuLab CL-SOM-iMX6 on SBC-FX6";
	compatible = "compulab,cl-som-imx6", "compulab,cm-fx6", "compulab,sbc-fx6", "fsl,imx6q";
};
