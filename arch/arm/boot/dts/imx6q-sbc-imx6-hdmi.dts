/*
* Copyright 2016 CompuLab Ltd.
*
* Author: Valentin Raevsky <valentin@compulab.co.il>
*
* The code contained herein is licensed under the GNU General Public
* License. You may obtain a copy of the GNU General Public License
* Version 2 or later at the following locations:
*
* http://www.opensource.org/licenses/gpl-license.html
* http://www.gnu.org/copyleft/gpl.html
*/

#include "imx6q-sbc-imx6.dts"

&mxcfb1 {
	mode_str ="1920x1080M@50";
	disp_dev = "hdmi";
};

&mxcfb2 {
	mode_str ="KD050C-WVGA";
	disp_dev = "lcd";
};
