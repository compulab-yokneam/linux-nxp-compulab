/*
 * Suppport for CompuLab SB-SOM-iMX6UL baseboard
 */

#include "imx6ul-cl-som-imx6ul-wilink.dts"
#include "imx6ul-sb-som-imx6ul.dtsi"

/ {
	model = "CompuLab CL-SOM-iMX6UL on SBC-SOM-iMX6UL";
	compatible = "fsl,imx6ul", "compulab,cl-som-imx6ul", "compulab,cl-sb-som-imx6ul";
};
